/ {
	amba_pl: amba_pl {
		ranges;
		compatible = "simple-bus";
		#address-cells = <1>;
		#size-cells = <1>;
		axi_bram_ctrl_0: axi_bram_ctrl@40000000 {
			xlnx,protocol = "AXI4";
			xlnx,edk-special = "BRAM_CTRL";
			compatible = "xlnx,axi-bram-ctrl-4.1";
			xlnx,ecc-onoff-reset-value = <0>;
			xlnx,ecc-type = <0>;
			xlnx,rd-cmd-optimization = <0>;
			xlnx,memory-depth = <2048>;
			xlnx,use-ecc = <0>;
			xlnx,rable = <0>;
			xlnx,fault-inject = <0>;
			xlnx,ip-name = "axi_bram_ctrl";
			reg = <0x40000000 0x10000>;
			xlnx,bmg-instance = "EXTERNAL";
			clocks = <&clkc 15>;
			xlnx,s-axi-ctrl-addr-width = <32>;
			xlnx,read-latency = <1>;
			xlnx,s-axi-supports-narrow-burst = <0>;
			xlnx,id-width = <0>;
			xlnx,supports-narrow-burst = <0>;
			xlnx,single-port-bram = <1>;
			xlnx,ecc = <0>;
			xlnx,edk-iptype = "PERIPHERAL";
			status = "okay";
			clock-names = "s_axi_aclk";
			xlnx,bram-addr-width = <11>;
			xlnx,bram-inst-mode = "EXTERNAL";
			xlnx,data-width = <256>;
			xlnx,s-axi-ctrl-data-width = <32>;
			xlnx,s-axi-id-width = <1>;
			xlnx,mem-depth = <2048>;
			xlnx,name = "axi_bram_ctrl_0";
		};
		ip_encapsulator_0: ip_encapsulator@60000000 {
			compatible = "xlnx,ip-encapsulator-1.0";
			xlnx,meta-width = <128>;
			xlnx,bram-data-width = <256>;
			xlnx,rable = <0>;
			xlnx,ip-name = "ip_encapsulator";
			reg = <0x60000000 0x20000000>;
			clocks = <&clkc 15>;
			xlnx,keep-width = <8>;
			xlnx,edk-iptype = "PERIPHERAL";
			status = "okay";
			clock-names = "clk";
			xlnx,bram-addr-width = <11>;
			xlnx,data-width = <64>;
			xlnx,name = "ip_encapsulator_0";
		};
	};
};
